## buildroot/external/Config.in
```kconfig
source "$BR2_EXTERNAL_EQUIP1_PATH/package/libdv/Config.in"
source "$BR2_EXTERNAL_EQUIP1_PATH/package/libavc1394/Config.in"
source "$BR2_EXTERNAL_EQUIP1_PATH/package/libiec61883/Config.in"
source "$BR2_EXTERNAL_EQUIP1_PATH/package/dvgrab/Config.in"
```

## buildroot/external/package/dvgrab/Config.in
```kconfig
config BR2_PACKAGE_DVGRAB
	bool "dvgrab"
	depends on BR2_INSTALL_LIBSTDCPP
	select BR2_PACKAGE_LIBRAW1394
	select BR2_PACKAGE_LIBAVC1394
	select BR2_PACKAGE_LIBIEC61883
	select BR2_PACKAGE_LIBDV
	help
	  Capture DV and HDV video and audio from FireWire (IEEE 1394)
	  camcorders, with AV/C transport control.

	  https://sourceforge.net/projects/kino/

comment "dvgrab needs a toolchain w/ C++"
	depends on !BR2_INSTALL_LIBSTDCPP
```

## buildroot/external/package/libavc1394/Config.in
```kconfig
config BR2_PACKAGE_LIBAVC1394
	bool "libavc1394"
	select BR2_PACKAGE_LIBRAW1394
	help
	  Library for the 1394 Trade Association AV/C (Audio/Video Control)
	  protocol, used to control camcorder transports. Required by dvgrab.

	  https://sourceforge.net/projects/libavc1394/
```

## buildroot/external/package/libiec61883/Config.in
```kconfig
config BR2_PACKAGE_LIBIEC61883
	bool "libiec61883"
	select BR2_PACKAGE_LIBRAW1394
	help
	  Library implementing IEC 61883 (DV/HDV/MPEG2-TS over IEEE 1394
	  isochronous transport). Required by dvgrab.

	  https://ieee1394.docs.kernel.org/
```

## software/buildroot/external/package/libdv/Config.in
```kconfig
config BR2_PACKAGE_LIBDV
	bool "libdv"
	select BR2_PACKAGE_POPT
	help
	  The Quasar DV codec (libdv): software decode/encode of DV video,
	  required by dvgrab.

	  https://libdv.sourceforge.net/
```
